## app/xiaozhi/Kconfig
```kconfig
config LVX_USE_DEMO_CONTEST2026_128_XIAOZHI
	bool "Contest 2026 team 128 XiaoZhi AI client"
	default n
	depends on LIBCXX
	depends on AUDIO
	depends on NET_TCP
	depends on NET_TCPPROTO_OPTIONS
	depends on GRAPHICS_LVGL
	depends on LV_USE_NUTTX
	depends on LV_USE_NUTTX_LCD || VIDEO_FB
	select LIB_OPUS
	select NETUTILS_CJSON
	select LIBUV
	select CRYPTO_MBEDTLS
	select OPENSSL_MBEDTLS_WRAPPER
	select NETUTILS_LIBWEBSOCKETS
	---help---
		Enable the XiaoZhi voice assistant client port.  The application uses
		only NuttX/POSIX interfaces plus openvela's packaged cJSON, Opus and
		libwebsockets libraries.

if LVX_USE_DEMO_CONTEST2026_128_XIAOZHI

config CONTEST2026_128_XIAOZHI_PROGNAME
	string "Program name"
	default "xiaozhi"

config CONTEST2026_128_XIAOZHI_PRIORITY
	int "Main task priority"
	default 100

config CONTEST2026_128_XIAOZHI_STACKSIZE
	int "Main task stack size"
	default 32768

config CONTEST2026_128_XIAOZHI_GUI_STACKSIZE
	int "LVGL worker stack size"
	range 8192 131072
	default 16384

config CONTEST2026_128_XIAOZHI_AUDIO_STACKSIZE
	int "Audio worker stack size"
	range 4096 131072
	default 8192
	help
		Stack size used independently by the capture and playback workers.

config CONTEST2026_128_XIAOZHI_AUDIO_DIAGNOSTICS
	bool "Print microphone bring-up statistics"
	default n
	help
		Print the captured PCM peak/mean amplitude and Opus frame/byte counts
		once per second while listening.  Enable this for I2S microphone
		bring-up, then disable it for normal use.

config CONTEST2026_128_XIAOZHI_WEBSOCKET_STACKSIZE
	int "WebSocket/TLS worker stack size"
	range 8192 131072
	default 24576

config CONTEST2026_128_XIAOZHI_WEBSOCKET_URL
	string "XiaoZhi WebSocket URL"
	default "wss://api.tenclass.net/xiaozhi/v1/"

config CONTEST2026_128_XIAOZHI_TOKEN
	string "Optional WebSocket bearer token"
	default ""

config CONTEST2026_128_XIAOZHI_TLS_CA_PATH
	string "TLS CA certificate path"
	default ""
	---help---
		PEM CA bundle used to verify a wss:// server.  Leave empty only when
		TLS_ALLOW_INSECURE is enabled for initial board bring-up.

config CONTEST2026_128_XIAOZHI_TLS_ALLOW_INSECURE
	bool "Allow unverified TLS during bring-up"
	default n
	---help---
		Disable server certificate and hostname verification.  This makes a
		board without a provisioned CA bundle usable for initial bring-up,
		but must be disabled for production firmware.

config CONTEST2026_128_XIAOZHI_PROTOCOL_VERSION
	int "Binary protocol version"
	range 1 3
	default 1

config CONTEST2026_128_XIAOZHI_CAPTURE_DEVPATH
	string "NuttX capture audio device"
	default "/dev/audio/pcm_in0"

config CONTEST2026_128_XIAOZHI_PLAYBACK_DEVPATH
	string "NuttX playback audio device"
	default "/dev/audio/pcm0"

config CONTEST2026_128_XIAOZHI_CLIENT_ID_PATH
	string "Persistent client identifier file"
	default "/data/xiaozhi-client-id"

config CONTEST2026_128_XIAOZHI_FB_DEVPATH
	string "LVGL display device"
	default "/dev/lcd0" if LV_USE_NUTTX_LCD
	default "/dev/fb0"

config CONTEST2026_128_XIAOZHI_INPUT_DEVPATH
	string "LVGL touchscreen device"
	default "/dev/input0"

endif
```
